#include <Wire.h>
#include <MS5611.h>
#include <I2Cdev.h>
#include <MPU6050_6Axis_MotionApps20.h>
#include <Adafruit_GFX.h>
#include <Adafruit_SSD1306.h>
#include <SPI.h>
#include <LoRa.h>

#define SCREEN_WIDTH 128
#define SCREEN_HEIGHT 64
#define OLED_MOSI 5
#define OLED_CLK 4
#define OLED_DC 7
#define OLED_CS 8
#define OLED_RESET 6

Adafruit_SSD1306 display(SCREEN_WIDTH, SCREEN_HEIGHT, OLED_MOSI, OLED_CLK, OLED_DC, OLED_RESET, OLED_CS);
MS5611 ms5611(0x77);
MPU6050 mpu;

int ax, ay, az;
int gx, gy, gz;
int x, y, z;
// int counter = 0;

// 'Fertigo', 60x30px
const unsigned char epd_bitmap_Fertigo [] PROGMEM = {
	0x00, 0x00, 0x00, 0x00, 0x00, 0x00, 0x00, 0x00, 0x00, 0x00, 0x00, 0x00, 0x00, 0x00, 0x00, 0x00, 
	0x00, 0x00, 0x00, 0x00, 0x00, 0x00, 0x00, 0x00, 0x00, 0x00, 0x00, 0x00, 0x00, 0x00, 0x00, 0x00, 
	0x00, 0x00, 0x00, 0x00, 0x00, 0x00, 0x00, 0x00, 0x00, 0x00, 0x00, 0x00, 0x00, 0x00, 0x00, 0x00, 
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	0x00, 0x00, 0x00, 0x00, 0x00, 0x00, 0x00, 0x00, 0x00, 0x00, 0x00, 0x00, 0x00, 0x00, 0x00, 0x00
};

// Array of all bitmaps for convenience. (Total bytes used to store images in PROGMEM = 256)
const int epd_bitmap_allArray_LEN = 1;
const unsigned char* epd_bitmap_allArray[1] = {
	epd_bitmap_Fertigo
};

void displayHESTIA() {
display.clearDisplay();
display.drawBitmap(70,45 , epd_bitmap_Fertigo, 60, 30, SSD1306_WHITE);
display.display();
}

void setup() {
  Serial.begin(9600);
  if (!display.begin(SSD1306_SWITCHCAPVCC, 0x3D)) {  // Change the address to your device address
    Serial.println(F("SSD1306 allocation failed"));
    while (1)
      ;  // Don't proceed, loop forever
  }
  display.display();
  delay(2000);
  display.clearDisplay();

  Wire.begin();
  mpu.initialize();
  if (!ms5611.begin()) {
    Serial.println("MS5611 not found, check wiring!");
    while (1)
      ;
  }

  while (!Serial)
    ;
  Serial.println("LoRa Sender");
  if (!LoRa.begin(433E6)) {
    Serial.println("Starting LoRa failed!");
    while (1)
      ;
  }
}

void loop() {
  // counter++;
  // Sensor Readings
  ms5611.read();
  float celsius = static_cast<float>(ms5611.getTemperature());

  float totalPressure = 0;
  const int NUM_READINGS = 100;  // Define the number of readings
  for (int i = 0; i < NUM_READINGS; i++) {
    ms5611.read();
    totalPressure += ms5611.getPressure();
    delay(10);
  }
  float avePressure = totalPressure / NUM_READINGS;

  mpu.getMotion6(&ax, &ay, &az, &gx, &gy, &gz);
  int x = map(ax, -17000, 17000, 0, 179);
  int y = map(ay, -17000, 17000, 0, 179);
  int z = map(az, -17000, 17000, 0, 179);

  // Display Sensor Readings on OLED
  display.clearDisplay();
  displayHESTIA();  // Display the NSM Logo
  display.setTextSize(1);
  display.setTextColor(SSD1306_WHITE);
  display.setCursor(1, 1);
  display.print("Temperature: ");
  display.print(celsius);
  display.println(" C");
  display.print("Pressure: ");
  display.print(avePressure);
  display.println(" hPa");
  display.print("Axis X: ");
  display.println(x);
  display.print("Axis Y: ");
  display.println(y);
  display.print("Axis Z: ");
  display.println(z);
  display.display();

  // LoRa Transmission
  LoRa.beginPacket();
  // LoRa.print(counter);
  // LoRa.print(",");
  LoRa.print(celsius);
  LoRa.print(",");
  LoRa.print(avePressure);
  LoRa.print(",");
  LoRa.print(x);
  LoRa.print(",");
  LoRa.print(y);
  LoRa.print(",");
  LoRa.print(z);
  LoRa.endPacket();
  delay(1000);
}